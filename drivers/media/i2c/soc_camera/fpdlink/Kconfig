## drivers/media/i2c/soc_camera/fpdlink/Kconfig
```kconfig
config SOC_CAMERA_TI9X4
	tristate "ti9x4 FPDLink3 support"
	depends on I2C
	help
	  This is an Texas Instruments ti9X4 FPDLink3 driver
```

## drivers/media/i2c/soc_camera/gmsl/Kconfig
```kconfig
config SOC_CAMERA_MAX9286
	tristate "max9286 GMSL support"
	depends on I2C
	help
	  This is a MAXIM max9286 GMSL driver

config SOC_CAMERA_MAX9288
	tristate "max9288 GMSL support"
	depends on I2C
	help
	  This is a MAXIM max9288 GMSL driver

config SOC_CAMERA_MAX9296
	tristate "max9296 GMSL2 support"
	depends on I2C
	select REGMAP_I2C
	help
	  This is a MAXIM max9296 GMSL2 driver

config SOC_CAMERA_MAX96712
	tristate "max96712 GMSL2 support"
	depends on I2C
	select REGMAP_I2C
	help
	  This is a MAXIM max96712 GMSL2 driver
```

## drivers/media/i2c/soc_camera/imagers/Kconfig
```kconfig
config SOC_CAMERA_OV106XX
	tristate "ov106xx camera support"
	depends on I2C
	help
	  This is a runtime detected GMSL1/GMSL2/FPDLink3 sensors driver
```
